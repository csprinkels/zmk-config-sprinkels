## config/boards/shields/sprinks/Kconfig.defconfig
```kconfig
if SHIELD_SPRINKS_LEFT

config ZMK_KEYBOARD_NAME
    default "Sprinks"

config ZMK_SPLIT_ROLE_CENTRAL
    default y

endif

if SHIELD_SPRINKS_LEFT || SHIELD_SPRINKS_RIGHT

config ZMK_SPLIT
    default y

endif
```

## config/boards/shields/sprinks/Kconfig.shield
```kconfig
config SHIELD_SPRINKS_LEFT
    def_bool $(shields_list_contains,sprinks_left)

config SHIELD_SPRINKS_RIGHT
    def_bool $(shields_list_contains,sprinks_right)
```
